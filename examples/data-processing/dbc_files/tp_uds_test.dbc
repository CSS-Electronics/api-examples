VERSION ""

NS_ :

BS_:

BU_:

BO_ 2026 Example_FE34E37D: 62 Vector__XXX
 SG_ M_SID_0x220101_TestSignalUDS m257 : 63|8@0+ (0.5,0) [0|0] "%" Vector__XXX
 SG_ response m98M : 15|16@0+ (1,0) [0|0] "unit" Vector__XXX
 SG_ service M : 7|8@0+ (1,0) [0|0] "" Vector__XXX

BO_ 2025 Example_0D2C6546: 62 Vector__XXX
 SG_ M_SID_0x220101_TestSignalUDS m257 : 63|8@0+ (0.5,0) [0|0] "%" Vector__XXX
 SG_ response m98M : 15|16@0+ (1,0) [0|0] "unit" Vector__XXX
 SG_ service M : 7|8@0+ (1,0) [0|0] "" Vector__XXX
 SG_ M_SID_0x220100_TestSignalUDS m256 : 71|8@0+ (1,0) [0|0] "" Vector__XXX

BA_DEF_ BO_  "VFrameFormat" ENUM  "StandardCAN","ExtendedCAN","StandardCAN_FD","ExtendedCAN_FD","J1939PG";
BA_DEF_  "ProtocolType" STRING ;
BA_DEF_DEF_  "VFrameFormat" "";
BA_DEF_DEF_  "ProtocolType" "";
BA_ "VFrameFormat" BO_ 2026 0;

SG_MUL_VAL_ 2026 M_SID_0x220101_TestSignalUDS response 257-257;
SG_MUL_VAL_ 2026 response service 98-98;
SG_MUL_VAL_ 2025 M_SID_0x220101_TestSignalUDS response 257-257;
SG_MUL_VAL_ 2025 response service 98-98;
SG_MUL_VAL_ 2025 M_SID_0x220100_TestSignalUDS response 256-256;
