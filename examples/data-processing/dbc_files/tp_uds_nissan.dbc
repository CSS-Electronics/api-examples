VERSION ""

NS_ :

BS_:

BU_:

BO_ 1979 SoC_Temp: 55 Vector__XXX
 SG_ SoC m1 : 271|24@0+ (1e-04,0) [0|0] "%" Vector__XXX
 SG_ BatPackTemp1 m4 : 32|8@1+ (1,0) [0|0] "%" Vector__XXX
 SG_ BatPackTemp2 m4 : 56|8@1+ (1,0) [0|0] "%" Vector__XXX
 SG_ BatPackTemp4 m4 : 104|8@1+ (1,0) [0|0] "%" Vector__XXX
 SG_ response m97M : 8|8@1+ (1,0) [0|0] "" Vector__XXX
 SG_ service M : 0|8@1+ (1,0) [0|0] "" Vector__XXX

BA_DEF_  "ProtocolType" STRING ;
BA_DEF_DEF_  "ProtocolType" "";

SG_MUL_VAL_ 1979 SoC response 1-1;
SG_MUL_VAL_ 1979 BatPackTemp1 response 4-4;
SG_MUL_VAL_ 1979 BatPackTemp2 response 4-4;
SG_MUL_VAL_ 1979 BatPackTemp4 response 4-4;
SG_MUL_VAL_ 1979 response service 97-97;
