VERSION ""

NS_ :

BS_:

BU_:

BO_ 1110 Message1: 8 Vector__XXX
 SG_ Signal1 : 0|8@1+ (1,10) [0|2550] "" Vector__XXX
