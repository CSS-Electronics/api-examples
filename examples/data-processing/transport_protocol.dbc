VERSION ""

NS_ :

BS_:

BU_:

BO_ 461 NormalMessage: 8 Vector__XXX
 SG_ signal_1 : 0|8@0+ (0.25,0) [0|16383.75] "rpm" Vector__XXX

BO_ 2025 TransportMsg: 8 Vector__XXX
 SG_ M_241_signal_1 m241 : 16|8@1+ (0.25,20) [0|0] "unit" Vector__XXX
 SG_ M_253_signal_1 m253 : 24|16@1+ (1,0) [0|0] "unit" Vector__XXX
 SG_ M_253_signal_2 m253 : 72|8@1+ (1,0) [0|0] "unit" Vector__XXX
 SG_ requested_ID M : 8|8@1+ (1,0) [0|255] "unit" Vector__XXX

BA_DEF_ BO_  "VFrameFormat" ENUM  "StandardCAN","ExtendedCAN","StandardCAN_FD","ExtendedCAN_FD","J1939PG";
BA_DEF_  "ProtocolType" STRING ;
BA_DEF_DEF_  "VFrameFormat" "";
BA_DEF_DEF_  "ProtocolType" "";
BA_ "VFrameFormat" BO_ 2025 0;

SG_MUL_VAL_ 2025 M_241_signal_1 requested_ID 241-241;
SG_MUL_VAL_ 2025 M_253_signal_1 requested_ID 253-253;
SG_MUL_VAL_ 2025 M_253_signal_2 requested_ID 253-253;
