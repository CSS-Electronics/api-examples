VERSION ""

NS_ :

BS_:

BU_:

BO_ 2566841342 EC1: 40 Vector__XXX
 SG_ EngineSpeedAtPoint5 : 96|16@1+ (0.125,0) [0|8031.875] "rpm" Vector__XXX

BA_DEF_ BO_  "VFrameFormat" ENUM  "StandardCAN","ExtendedCAN","StandardCAN_FD","ExtendedCAN_FD","J1939PG";
BA_DEF_  "ProtocolType" STRING ;
BA_DEF_DEF_  "VFrameFormat" "";
BA_DEF_DEF_  "ProtocolType" "J1939PG";
BA_ "ProtocolType" "";
BA_ "VFrameFormat" BO_ 2566841342 1;
