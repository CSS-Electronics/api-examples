VERSION ""

NS_ :

BS_:

BU_:

BO_ 2028 Battery: 62 Vector__XXX
 SG_ M_SID_0x220101_StateOfChargeBMS m257 : 56|8@1+ (0.5,0) [0|0] "%" Vector__XXX
 SG_ response m98M : 15|16@0+ (1,0) [0|0] "unit" Vector__XXX
 SG_ service M : 7|8@0+ (1,0) [0|0] "" Vector__XXX

BO_ 1979 Temperature: 54 Vector__XXX
 SG_ M_SID_0x220100_IndoorTemp m256 : 64|8@1+ (0.5,-40) [0|0] "degC" Vector__XXX
 SG_ response m98 : 15|16@0+ (1,0) [0|0] "unit" Vector__XXX
 SG_ service M : 7|8@0+ (1,0) [0|0] "" Vector__XXX
 SG_ M_SID_0x220100_OutdoorTemp : 79|8@0+ (0.5,-40) [0|0] "" Vector__XXX

BA_DEF_ BO_  "VFrameFormat" ENUM  "StandardCAN","ExtendedCAN","StandardCAN_FD","ExtendedCAN_FD","J1939PG";
BA_DEF_  "ProtocolType" STRING ;
BA_DEF_DEF_  "VFrameFormat" "";
BA_DEF_DEF_  "ProtocolType" "";
BA_ "VFrameFormat" BO_ 2028 0;

SG_MUL_VAL_ 2028 M_SID_0x220101_StateOfChargeBMS response 257-257;
SG_MUL_VAL_ 2028 response service 98-98;
